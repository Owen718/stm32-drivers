
#include "sys.h" 
#include "usart.h"     
#include "delay.h"
#include "timer.h"
#define USART_CS 8			//宏定义串口接收超时
#define TIME3_max 60000000			//宏定义定时器3计数最大值
u32 TIME2=0;
u32 TIME2_1=0;
u32 TIME2_2=0;
u8 flag_time2=0;
u8 flag_time2_2=0;
u32 TIME3=0;    					  
//u16 TIME4=0;    
//u16 TIME4=0;
//u32 TIME5=0;   
//u32 TIME8=0;
extern u32 JS_old,JS_old2,JS_old3;//声明定义串口接收中断里面的现在值、过去值、和差值。

/*************************************************************************
函数名称: void TIM2_Int_Init(void) 
函数说明:定时器2中断初始化程序
函数功能:
函数变量:
注    意:
//通用定时器3中断初始化
//这里时钟选择为APB1的2倍，而APB1为36M
//arr：自动重装值。
//psc：时钟预分频数
//这里使用的是定时器3!
//Tout= ((arr+1)*(psc+1))/Tclk；
//Tclk：TIM3 的输入时钟频率（单位为 Mhz）
//Tout：TIM3 溢出时间（单位为 us）
*************************************************************************/

void TIM2_Int_Init(u16 arr,u16 psc)
{
	RCC->APB1ENR|=1<<0;	//TIM2时钟使能    
 	TIM2->ARR=arr;  	//设定计数器自动重装值//刚好1ms    
	TIM2->PSC=psc;  	//预分频器7200,得到10Khz的计数时钟		//预分频器720,得到100Khz的计数时钟	一次计数是10us  
	TIM2->DIER|=1<<0;   //允许更新中断	  
	TIM2->CR1|=0x01;    //使能定时器2  初始化定时器必须打开，否则第一次接收不能正常
	//TIM2->CR1&=0x00;    //关闭定时器2
  	MY_NVIC_Init(1,2,TIM2_IRQChannel,2);//抢占1，子优先级3，组2									 
}
/*************************************************************************
函数名称: void TIM2_IRQHandler(void) 
函数说明:定时器2中断程序
函数功能:
函数变量:
注    意:
*************************************************************************/	 	 
void TIM2_IRQHandler(void)	//用于速度计算
{
  if(TIM2->SR&0X0001)     //溢出中断
	{
		TIME2++;
		if(TIME2==200)			//定时2秒钟 询问一次电流数据
		{
			TIME2=0;
			flag_time2=1;
			TIME2_2++;			//计数器 用于计时一分钟 给服务器发送数据
			if(TIME2_2==30)//计时达到一分钟
			{
				TIME2_2=0;
				flag_time2_2=1;
				TIME2_1++;
			}
		}
		
  }
  TIM2->SR&=~(1<<0);//清除中断标志位
}
/*************************************************************************
函数名称: void TIM3_Int_Init(void) 
函数说明:定时器3中断初始化程序
函数功能:
函数变量:
注    意:
//通用定时器3中断初始化
//这里时钟选择为APB1的2倍，而APB1为36M
//arr：自动重装值。
//psc：时钟预分频数
//这里使用的是定时器3!
//Tout= ((arr+1)*(psc+1))/Tclk；
//Tclk：TIM3 的输入时钟频率（单位为 Mhz）
//Tout：TIM3 溢出时间（单位为 us）
*************************************************************************/

void TIM3_Int_Init(u16 arr,u16 psc)
{
	RCC->APB1ENR|=1<<1;	//TIM3时钟使能    
 	TIM3->ARR=arr;  	//设定计数器自动重装值//刚好1ms    
	TIM3->PSC=psc;  	//预分频器7200,得到10Khz的计数时钟		//预分频器720,得到100Khz的计数时钟	一次计数是10us  
	TIM3->DIER|=1<<0;   //允许更新中断	  
	TIM3->CR1|=0x01;    //使能定时器3
	//TIM3->CR1&=0x00;    //关闭定时器3
  	MY_NVIC_Init(2,0,TIM3_IRQChannel,2);//抢占1，子优先级3，组2									 
} 

/*************************************************************************
函数名称: void TIM3_IRQHandler(void) 
函数说明:定时器3中断程序
函数功能:
函数变量:
注    意:
*************************************************************************/	 	 
void TIM3_IRQHandler(void)	//用于速度计算
{ 		    		  			    
	if(TIM3->SR&0X0001)     //溢出中断
	{	
		TIME3++;    //0.5ms计一个数
		if(TIME3>=TIME3_max)	  //如果定时器3计数器达到一定数值
		{
			TIME3=0;	   //定时器3计数器清零
			if((TIME3_max-JS_old)<=8)	  //如果过去值接近最大值的时候有清零动作，将过去值也清零 以防接收的时候出现数据分裂
			{
				JS_old=0;
			}
			else
			{JS_old=0;TIME3=9;}
			if((TIME3_max-JS_old2)<=8)	  //如果过去值接近最大值的时候有清零动作，将过去值也清零 以防接收的时候出现数据分裂
			{
				JS_old=0;
			}
			else
			{JS_old2=0;TIME3=9;}
			if((TIME3_max-JS_old3)<=8)	  //如果过去值接近最大值的时候有清零动作，将过去值也清零 以防接收的时候出现数据分裂
			{
				JS_old3=0;
			}
			else
			{JS_old3=0;TIME3=9;}
		}				    				   				     	    	
	}				   
	TIM3->SR&=~(1<<0);      //清除中断标志位 	    
} 

/*************************************************************************
函数名称: void TIM4_Int_Init(void) 
函数说明:定时器4中断初始化程序
函数功能:
函数变量:
注    意:

//这里时钟选择为APB1的2倍，而APB1为36M
//arr：自动重装值。
//psc：时钟预分频数
//这里使用的是定时器3!
//Tout= ((arr+1)*(psc+1))/Tclk；
//Tclk：TIM4 的输入时钟频率（单位为 Mhz）
//Tout：TIM4 溢出时间（单位为 us）
*************************************************************************/

/*void TIM4_Int_Init(u16 arr,u16 psc)
{
	RCC->APB1ENR|=1<<2;	//TIM4时钟使能    
 	TIM4->ARR=arr;  	//设定计数器自动重装值//刚好1ms    
	TIM4->PSC=psc;  	//预分频器7200,得到10Khz的计数时钟		//预分频器720,得到100Khz的计数时钟	一次计数是10us  
	TIM4->DIER|=1<<0;   //允许更新中断	  
	//TIM4->CR1|=0x01;    //使能定时器4
	//TIM4->CR1&=0x00;    //关闭定时器4
  	MY_NVIC_Init(2,1,TIM4_IRQChannel,2);//抢占2，子优先级1，组2									 
} */
/*************************************************************************
函数名称: void TIM4_IRQHandler(void) 
函数说明:定时器4中断程序
函数功能:
函数变量:
注    意:
*************************************************************************/	 
/*void TIM4_IRQHandler(void)   //1秒钟时钟
{ 		    		  			    
	if(TIM4->SR&0X0001)//溢出中断
	{		   				     	    	
	}				   
	TIM4->SR&=~(1<<0);//清除中断标志位 	    
}  */

/*************************************************************************
函数名称: void TIM5_Int_Init(void) 
函数说明:定时器5中断初始化程序
函数功能:
函数变量:
注    意:
//这里时钟选择为APB1的2倍，而APB1为36M
//arr：自动重装值。
//psc：时钟预分频数
//这里使用的是定时器3!
//Tout= ((arr+1)*(psc+1))/Tclk；
//Tclk：TIM5 的输入时钟频率（单位为 Mhz）
//Tout：TIM5 溢出时间（单位为 us）
*************************************************************************/
/*void TIM5_Int_Init(u16 arr,u16 psc)	//轴间距计算
{
	RCC->APB1ENR|=1<<3;	//TIM3时钟使能    
 	TIM5->ARR=arr;  	//设定计数器自动重装值//刚好1ms    
	TIM5->PSC=psc;  	//预分频器7200,得到10Khz的计数时钟		//预分频器720,得到100Khz的计数时钟	一次计数是10us  
	TIM5->DIER|=1<<0;   //允许更新中断	  
	//TIM5->CR1|=0x01;    //使能定时器5
	TIM5->CR1&=0x00;    //关闭定时器5
  	MY_NVIC_Init(2,2,TIM5_IRQChannel,2);//抢占1，子优先级3，组2									 
}*/
/*************************************************************************
函数名称: void TIM5_IRQHandler(void) 
函数说明:定时器5中断程序
函数功能:
函数变量:
注    意:
*************************************************************************/	 
/*void TIM5_IRQHandler(void)
{ 		    		  			    
	if(TIM5->SR&0X0001)//溢出中断
	{	
		TIME5++;    //1ms计一个数		    				   				     	    	
	}				   
	TIM5->SR&=~(1<<0);//清除中断标志位 	    
} */

/*************************************************************************
函数名称: void TIM6_Int_Init(void) 
函数说明:定时器5中断初始化程序
函数功能:
函数变量:
注    意:
//这里时钟选择为APB1的2倍，而APB1为36M
//arr：自动重装值。
//psc：时钟预分频数
//这里使用的是定时器3!
//Tout= ((arr+1)*(psc+1))/Tclk；
//Tclk：TIM5 的输入时钟频率（单位为 Mhz）
//Tout：TIM5 溢出时间（单位为 us）
*************************************************************************/
/*void TIM6_Int_Init(u16 arr,u16 psc)	//轴间距计算
{
	RCC->APB1ENR|=1<<4;	//TIM3时钟使能    
 	TIM6->ARR=arr;  	//设定计数器自动重装值//刚好1ms    
	TIM6->PSC=psc;  	//预分频器7200,得到10Khz的计数时钟		//预分频器720,得到100Khz的计数时钟	一次计数是10us  
	TIM6->DIER|=1<<0;   //允许更新中断	  
	TIM6->CR1|=0x01;    //使能定时器5
	//TIM6->CR1&=0x00;    //关闭定时器5
  	MY_NVIC_Init(2,3,TIM6_IRQChannel,2);//抢占1，子优先级3，组2									 
}*/
/*************************************************************************
函数名称: void TIM5_IRQHandler(void) 
函数说明:定时器5中断程序
函数功能:
函数变量:
注    意:
*************************************************************************/	 
/*void TIM6_IRQHandler(void)
{ 		    		  			    
   if(TIM6->SR&0X0001)     //溢出中断
	{

    }
   TIM6->SR&=~(1<<0);//清除中断标志位	 	    
} */

/*************************************************************************
函数名称: void TIM7_Int_Init(void) 
函数说明:定时器5中断初始化程序
函数功能:
函数变量:
注    意:
//这里时钟选择为APB1的2倍，而APB1为36M
//arr：自动重装值。
//psc：时钟预分频数
//这里使用的是定时器3!
//Tout= ((arr+1)*(psc+1))/Tclk；
//Tclk：TIM5 的输入时钟频率（单位为 Mhz）
//Tout：TIM5 溢出时间（单位为 us）
*************************************************************************/
/*void TIM7_Int_Init(u16 arr,u16 psc)	//轴间距计算
{
	RCC->APB1ENR|=1<<5;	//TIM3时钟使能    
 	TIM7->ARR=arr;  	//设定计数器自动重装值//刚好1ms    
	TIM7->PSC=psc;  	//预分频器7200,得到10Khz的计数时钟		//预分频器720,得到100Khz的计数时钟	一次计数是10us  
	TIM7->DIER|=1<<0;   //允许更新中断	  
	TIM7->CR1|=0x01;    //使能定时器7
	//TIM7->CR1&=0x00;    //关闭定时器7
  	MY_NVIC_Init(1,3,TIM7_IRQChannel,2);//抢占1，子优先级3，组2									 
}*/
/*************************************************************************
函数名称: void TIM5_IRQHandler(void) 
函数说明:定时器5中断程序
函数功能:
函数变量:
注    意:
*************************************************************************/	 
/*void TIM7_IRQHandler(void)
{ 		    		  			    
   if(TIM7->SR&0X0001)     //溢出中断
	{

    }
   TIM7->SR&=~(1<<0);//清除中断标志位	 	    
}  */

/*************************************************************************
函数名称: void TIM2_Int_Init(void) 
函数说明:定时器2中断初始化程序
函数功能:
函数变量:
注    意:
//通用定时器3中断初始化
//这里时钟选择为APB1的2倍，而APB1为36M
//arr：自动重装值。
//psc：时钟预分频数
//这里使用的是定时器3!
//Tout= ((arr+1)*(psc+1))/Tclk；
//Tclk：TIM3 的输入时钟频率（单位为 Mhz）
//Tout：TIM3 溢出时间（单位为 us）
*************************************************************************/

/*void TIM8_Int_Init(u16 arr,u16 psc)
{
	//RCC->APB1ENR|=1<<0;	//TIM2时钟使能 
	RCC->APB2ENR|=1<<13;	//TIM8时钟使能   
 	TIM8->ARR=arr;  	//设定计数器自动重装值//刚好1ms    
	TIM8->PSC=psc;  	//预分频器7200,得到10Khz的计数时钟		//预分频器720,得到100Khz的计数时钟	一次计数是10us  
	TIM8->DIER|=1<<0;   //允许更新中断	  
	//TIM8->CR1|=0x01;    //使能定时器2  初始化定时器必须打开，否则第一次接收不能正常
	TIM8->CR1&=0x00;    //关闭定时器2
  	MY_NVIC_Init(3,2,TIM8_UP_IRQChannel,2);//抢占1，子优先级3，组3									 
} */
/*************************************************************************
函数名称: void TIM8_IRQHandler(void) 
函数说明:定时器8中断程序
函数功能:
函数变量:
注    意:
*************************************************************************/	 	 
/*void TIM8_UP_IRQHandler(void)	//轴组速度计算
{ 		    		  			    
	if(TIM8->SR&0X0001)     //溢出中断
	{	
		TIME8++;    //1ms计一个数		  				   				     	    	
	}				   
	TIM8->SR&=~(1<<0);      //清除中断标志位 	    
}  */



/*************************************************************************
函数名称: void TIM2_Int_Init(void) 
函数说明:定时器2中断初始化程序
函数功能:
函数变量:
注    意:
//通用定时器3中断初始化
//这里时钟选择为APB1的2倍，而APB1为36M
//arr：自动重装值。
//psc：时钟预分频数
//这里使用的是定时器3!
//Tout= ((arr+1)*(psc+1))/Tclk；
//Tclk：TIM3 的输入时钟频率（单位为 Mhz）
//Tout：TIM3 溢出时间（单位为 us）
*************************************************************************/

/*void TIM1_Int_Init(u16 arr,u16 psc)
{
	RCC->APB2ENR|=1<<11;	//TIM1时钟使能   
 	TIM1->ARR=arr;  	//设定计数器自动重装值//刚好1ms    
	TIM1->PSC=psc;  	//预分频器7200,得到10Khz的计数时钟		//预分频器720,得到100Khz的计数时钟	一次计数是10us  
	TIM1->DIER|=1<<0;   //允许更新中断	  
	TIM1->CR1|=0x01;    //使能定时器2  初始化定时器必须打开，否则第一次接收不能正常
	//TIM1->CR1&=0x00;    //关闭定时器2
    MY_NVIC_Init(1,0,TIM1_UP_IRQChannel,2);//抢占1，子优先级3，组3
									 
}  */


/*************************************************************************
函数名称: void TIM1_UP_TIM10_IRQHandler(void) 
函数说明:定时器1中断程序
函数功能:
函数变量:
注    意:TIM1_UP_TIM10_IRQHandler 
*************************************************************************/	 	 
/*void TIM1_UP_IRQHandler(void)	//轴组速度计算
{ 		    		  			    
	if(TIM1->SR&0X0001)     //溢出中断
	{
 
	}				   
	TIM1->SR&=~(1<<0);      //清除中断标志位 	    
}	 */


